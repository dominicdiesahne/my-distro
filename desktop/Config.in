## desktop/Config.in
```kconfig
source "$BR2_EXTERNAL_MY_DISTRO_PATH/package/my-init/Config.in"
source "$BR2_EXTERNAL_MY_DISTRO_PATH/package/my-panel/Config.in"
source "$BR2_EXTERNAL_MY_DISTRO_PATH/package/my-login/Config.in"
source "$BR2_EXTERNAL_MY_DISTRO_PATH/package/my-history/Config.in"
source "$BR2_EXTERNAL_MY_DISTRO_PATH/package/my-search/Config.in"
source "$BR2_EXTERNAL_MY_DISTRO_PATH/package/my-search-model/Config.in"
source "$BR2_EXTERNAL_MY_DISTRO_PATH/package/my-settings/Config.in"
source "$BR2_EXTERNAL_MY_DISTRO_PATH/package/my-ide/Config.in"
source "$BR2_EXTERNAL_MY_DISTRO_PATH/package/my-emoji-font/Config.in"
source "$BR2_EXTERNAL_MY_DISTRO_PATH/package/my-locale/Config.in"
```

## desktop/package/my-emoji-font/Config.in
```kconfig
config BR2_PACKAGE_MY_EMOJI_FONT
	bool "my-emoji-font"
	help
	  Noto Color Emoji (SIL Open Font License), so emoji show up in
	  colour in GTK apps, the browser and the terminal.
```

## desktop/package/my-history/Config.in
```kconfig
config BR2_PACKAGE_MY_HISTORY
	bool "my-history"
	depends on BR2_PACKAGE_XORG7
	select BR2_PACKAGE_XLIB_LIBX11
	select BR2_PACKAGE_XLIB_LIBXFT
	help
	  System-wide file history: my-historyd saves a version of every
	  changed file, my-undo and my-history restore them.
```

## desktop/package/my-ide/Config.in
```kconfig
config BR2_PACKAGE_MY_IDE
	bool "my-ide"
	depends on BR2_x86_64 && BR2_TOOLCHAIN_USES_GLIBC  # prebuilt Neovim
	select BR2_PACKAGE_GIT        # lazy.nvim installs and updates plugins
	select BR2_PACKAGE_RIPGREP    # search in files
	select BR2_PACKAGE_FD         # find files
	help
	  The IDE of my-distro: Neovim with LazyVim. Plugins and
	  tree-sitter parsers are installed while building, so it
	  works without internet. Start it with my-ide.
```

## desktop/package/my-init/Config.in
```kconfig
config BR2_PACKAGE_MY_INIT
	bool "my-init"
	help
	  my-distro's own PID 1, written in C (init/init.c).
	  Installed as /sbin/my-init and started with init=/sbin/my-init.
```

## desktop/package/my-locale/Config.in
```kconfig
config BR2_PACKAGE_MY_LOCALE
	bool "my-locale"
	help
	  Translations of my-distro's own programs (po/*.po), compiled
	  into /usr/share/locale/*/LC_MESSAGES/my-distro.mo.
```

## desktop/package/my-login/Config.in
```kconfig
config BR2_PACKAGE_MY_LOGIN
	bool "my-login"
	depends on BR2_PACKAGE_XORG7
	select BR2_PACKAGE_XLIB_LIBX11
	select BR2_PACKAGE_XLIB_LIBXFT
	select BR2_PACKAGE_XLIB_LIBXRENDER
	select BR2_PACKAGE_XLIB_LIBXSCRNSAVER
	select BR2_PACKAGE_IMLIB2
	select BR2_PACKAGE_IMLIB2_X
	select BR2_PACKAGE_IMLIB2_PNG
	select BR2_PACKAGE_LIBXCRYPT
	help
	  The my-distro login screen, and my-power (reboot/power off
	  for normal users).
```

## desktop/package/my-lua54/Config.in
```kconfig
config BR2_PACKAGE_MY_LUA54
	bool "my-lua54"
	help
	  Lua 5.4 as a static library for WirePlumber only
	  (my-wireplumber). The image's Lua is LuaJIT (mpv), and
	  Buildroot allows only one Lua package.
```

## desktop/package/my-panel/Config.in
```kconfig
config BR2_PACKAGE_MY_PANEL
	bool "my-panel"
	depends on BR2_PACKAGE_XORG7
	select BR2_PACKAGE_XLIB_LIBX11
	select BR2_PACKAGE_XLIB_LIBXFT
	select BR2_PACKAGE_IMLIB2
	select BR2_PACKAGE_IMLIB2_X
	select BR2_PACKAGE_IMLIB2_PNG
	select BR2_PACKAGE_CAIRO
	select BR2_PACKAGE_ALSA_LIB
	select BR2_PACKAGE_ALSA_LIB_MIXER
	help
	  The my-distro taskbar: start menu, window buttons, clock,
	  volume and battery; and my-screenshot.
```

## desktop/package/my-search-model/Config.in
```kconfig
config BR2_PACKAGE_MY_SEARCH_MODEL
	bool "my-search-model"
	help
	  The all-MiniLM-L6-v2 embedding model used by my-search.
```

## desktop/package/my-search/Config.in
```kconfig
config BR2_PACKAGE_MY_SEARCH
	bool "my-search"
	depends on BR2_PACKAGE_XORG7
	depends on BR2_PACKAGE_LLAMA_CPP
	select BR2_PACKAGE_MY_SEARCH_MODEL
	select BR2_PACKAGE_XLIB_LIBX11
	select BR2_PACKAGE_XLIB_LIBXFT
	help
	  Semantic file search: my-indexd indexes your files by meaning
	  with the all-MiniLM-L6-v2 embedding model, my-search and
	  my-search-gui search them.
```

## desktop/package/my-secureboot/Config.in
```kconfig
config BR2_PACKAGE_MY_SECUREBOOT
	bool "my-secureboot"
	depends on BR2_x86_64
	help
	  Secure Boot for my-distro: Debian's shim (signed by Microsoft)
	  and MokManager, and my-distro's public Secure Boot certificate,
	  in /usr/lib/my-distro/efi for the ISO and the installer. GRUB
	  and the kernel are signed with my-distro's key by
	  `make desktop-secureboot` (desktop/post-build.sh).
```

## desktop/package/my-settings/Config.in
```kconfig
config BR2_PACKAGE_MY_SETTINGS
	bool "my-settings"
	depends on BR2_PACKAGE_XORG7
	select BR2_PACKAGE_LIBGTK3
	select BR2_PACKAGE_CAIRO
	help
	  The Settings app (colors, wallpaper, clock, taskbar) and the
	  Clock app of my-distro (settings/).
```

## desktop/package/my-wireplumber/Config.in
```kconfig
config BR2_PACKAGE_MY_WIREPLUMBER
	bool "my-wireplumber"
	depends on BR2_PACKAGE_PIPEWIRE
	select BR2_PACKAGE_MY_LUA54
	select BR2_PACKAGE_LIBGLIB2
	help
	  WirePlumber, PipeWire's session manager, built with its own
	  Lua 5.4 (my-lua54) so it can be in the image next to LuaJIT.
```

## desktop/package/tinycc/Config.in
```kconfig
config BR2_PACKAGE_TINYCC
	bool "tinycc"
	depends on BR2_x86_64
	help
	  Tiny C Compiler (tcc): a small C compiler that runs on
	  my-distro itself, with the C library's headers and start
	  files. A package of the Software app.

	  https://repo.or.cz/tinycc.git
```
